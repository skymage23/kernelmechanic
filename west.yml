## west.yml
```yaml
manifest:
  remotes:
    - name: zephyrproject-rtos
      url-base: https://github.com/zephyrproject-rtos

    - name: kernelmechanic
      url-base: https://github.com/skymage23

  projects:
    - name: zephyr
      remote: zephyrproject-rtos
      revision: v3.5.0
      import: true

  self:
    path: kernelmechanic
```
